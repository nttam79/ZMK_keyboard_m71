## config/boards/arm/nice_nano /Kconfig.board
```kconfig
# Copyright (c) 2021 Nick Winans
# SPDX-License-Identifier: MIT

config BOARD_NICE_NANO
    bool "nice!nano"
    depends on SOC_NRF52840_QIAA

config BOARD_NICE_NANO_V2
    bool "nice!nano v2"
    depends on SOC_NRF52840_QIAA
```

## config/boards/shields/M71mod/Kconfig.shield
```kconfig
# Copyright (c) 2020 The ZMK Contributors
# SPDX-License-Identifier: MIT

config SHIELD_M71MOD
    def_bool $(shields_list_contains,M71mod)
```
